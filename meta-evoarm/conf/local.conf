## meta-evoarm/conf/local.conf
```bitbake
# Local configuration for meta-wandboard images
# Yocto Project 2.7 Poky distribution [warrior] branch
# This is a sysvinit system

LICENSE_FLAGS_WHITELIST = "commercial"

DISTRO_FEATURES = "bluetooth alsa usbhost ${DISTRO_FEATURES_LIBC} ptest systemd opengl wayland wifi"
VIRTUAL-RUNTIME_init_manager = "systemd"

DISTRO_FEATURES_BACKFILL_CONSIDERED = "sysvinit"

# PREFERRED_PROVIDER_jpeg = "libjpeg-turbo"

# PREFERRED_PROVIDER_udev = "udev"

# default is 5.0
# PREFERRED_VERSION_linux-stable = "4.19.%"

MACHINE = "wandboard"

DL_DIR = "/work/downloads"
SSTATE_DIR = "/work/sstate-cache"
# TMPDIR = "/work/evoarm-tmp"

DISTRO = "poky"

PACKAGE_CLASSES = "package_ipk"

# i686 or x86_64
SDKMACHINE = "x86_64"

# SD_UPGRADER_BOOT = "1"

# no root password
# EXTRA_IMAGE_FEATURES = "debug-tweaks"

IMAGE_FSTYPES = "ext4 tar.gz"

# root password set to 'evoarm'
INHERIT += "extrausers"
EXTRA_USERS_PARAMS = "usermod -P evoarm root; "

# force change password on first login
#INHERIT += "chageusers"
#CHAGE_USERS_PARAMS = "chage -d0 root; "

# INHERIT += "cve-check"

USER_CLASSES = "image-mklibs image-prelink"

PATCHRESOLVE = "noop"
RM_OLD_IMAGE = "1"
# INHERIT += "rm_work"
CONF_VERSION = "1"

PREFERRED_PROVIDER_u-boot-fw-utils = "libubootenv"
```
