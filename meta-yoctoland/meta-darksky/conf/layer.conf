## meta-yoctoland/meta-darksky/conf/layer.conf
```bitbake
# We have a conf and classes directory, append to BBPATH
BBPATH .= ":${LAYERDIR}"

BBFILES += "${LAYERDIR}/recipes*/*/*.bb ${LAYERDIR}/recipes*/*/*.bbappend ${LAYERDIR}/images/*.bb"

BBFILE_COLLECTIONS += "meta-darksky"
BBFILE_PATTERN_meta-darksky := "^${LAYERDIR}/"
BBFILE_PRIORITY_meta-darksky = "16"

LAYERSERIES_COMPAT_meta-darksky = "rocko sumo thud warrior zeus dunfell kirkstone"
```

## meta-yoctoland/meta-evoarm/conf/machine/ts-7970.conf
```bitbake
#@TYPE: Machine
#@NAME: Technologic Systems i.MX6 Boards
#@SOC: i.MX6
#@DESCRIPTION: Machine configuration for i.MX6
#@MAINTAINER: Mark Featherston <mark@embeddedarm.com>

SOC_FAMILY = "mx6:mx6q:ts7970"
TARGET_ARCH = "arm"

DEFAULTTUNE ?= "cortexa9hf-neon"

include conf/machine/include/soc-family.inc
include conf/machine/include/arm/armv7a/tune-cortexa9.inc

include conf/machine/include/imx-base.inc


UBOOT_MACHINE = "ts7970-q-2g-1000mhz-c_config"
UBOOT_ENTRYPOINT = "0x10008000"
UBOOT_LOADADDRESS = "0x10008000"
PREFERRED_PROVIDER_virtual/bootloader ?= "u-boot"

KERNEL_EXTRA_ARGS += "LOADADDR=${UBOOT_ENTRYPOINT}"

PREFERRED_PROVIDER_virtual/kernel ?= "linux-tsimx"

KERNEL_DEVICETREE = "nxp/imx/imx6q-ts7970.dtb nxp/imx/imx6dl-ts7970.dtb"
KERNEL_CLASSES += " kernel-fitimage"
KERNEL_IMAGETYPES = "uImage fitImage"

WKS_FILE = "ts_4gb_emmc.wks"

# swupdate post install script
SWU_SCRIPT ?= "update.lua"

SERIAL_CONSOLE = "115200 ttymxc0"

MACHINE_ESSENTIAL_EXTRA_RDEPENDS += "kernel-devicetree firmware-imx-sdma-imx6q kernel-modules"

MACHINE_FEATURES += "screen usbgadget usbhost vfat ext2 alsa 3g pci wifi bluetooth touchscreen"

hostname:pn-base-files = "ts-imx6"
IMAGE_FSTYPES = "ext4.gz"

IMAGE_INSTALL:append = " u-boot libubootenv libubootenv-bin ts-uboot-env ts-hwrev ts-hw-config"

EXTRA_IMAGECMD:append = " -O ^metadata_csum -O ^64bit"
```
